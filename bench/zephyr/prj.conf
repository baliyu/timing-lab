## CMakeLists.txt
```
cmake_minimum_required(VERSION 3.20.0)
find_package(Zephyr REQUIRED HINTS $ENV{ZEPHYR_BASE})
project(timing_lab_bench)

# the comparisons and the portable bench core are shared with the PC build; only src/main.c is specific to the board
target_sources(app PRIVATE
    src/main.c
    ${CMAKE_CURRENT_LIST_DIR}/../core/timing_core.c
    ${CMAKE_CURRENT_LIST_DIR}/../../c/compare.c)
target_include_directories(app PRIVATE
    ${CMAKE_CURRENT_LIST_DIR}/../core
    ${CMAKE_CURRENT_LIST_DIR}/../../c)
```

## prj.conf
```kconfig
# USB console (the same settings as in dsp-lab and mcuboot-lab)
CONFIG_GPIO=y
CONFIG_SERIAL=y
CONFIG_CONSOLE=y
CONFIG_UART_CONSOLE=y
CONFIG_STDOUT_CONSOLE=y
CONFIG_UART_LINE_CTRL=y
CONFIG_PRINTK=y
CONFIG_USB_DEVICE_STACK_NEXT=y
CONFIG_CDC_ACM_SERIAL_INITIALIZE_AT_BOOT=y
CONFIG_CDC_ACM_SERIAL_PRODUCT_STRING="timing-lab bench"

# the same optimisation as the dsp-lab bench, so the comparisons are built the way the other Nano code is
CONFIG_SPEED_OPTIMIZATIONS=y
CONFIG_MAIN_STACK_SIZE=4096
```

## boards/arduino_nano_33_ble.overlay
```dts
/* Console over USB (CDC ACM). The flash layout is the board's default: the app starts at 0x10000, behind the Arduino bootloader. */
/ {
	chosen {
		zephyr,console = &cdc_acm_uart0;
	};
};

&zephyr_udc0 {
	cdc_acm_uart0: cdc_acm_uart0 {
		compatible = "zephyr,cdc-acm-uart";
	};
};
```

## src/main.c
```c
/* timing-lab bench, board side: the cycle counter, interrupt masking and the USB console for timing_core.  Arduino Nano 33 BLE (nRF52840, Cortex-M4F).
   Adapted from the dsp-lab bench.  Built with AI assistance (Claude).

   The cycle counter is the Cortex-M4 DWT cycle counter (DWT->CYCCNT, one count per CPU clock).  Zephyr's k_cycle_get_32() is only the 32.768 kHz RTC on this
   chip and is used here just to measure the CPU clock. */
#include <zephyr/device.h>
#include <zephyr/drivers/uart.h>
#include <zephyr/kernel.h>
#include <zephyr/version.h>

#include <cmsis_core.h>

#include "compare.h"
#include "timing_core.h"

#define REPEATS 1000u
#define PAUSE_BETWEEN_RUNS_S 10

static uint32_t plat_cycles(void) { return DWT->CYCCNT; }
static unsigned plat_irq_lock(void) { return irq_lock(); }
static void plat_irq_unlock(unsigned key) { irq_unlock(key); }

static void plat_emit(const char *line)
{
	printk("%s\n", line);
	k_msleep(5);                                    /* the USB serial buffer is small; do not outrun the PC */
}

/* Turns the DWT cycle counter on and proves it counts. */
static bool dwt_start(void)
{
	CoreDebug->DEMCR |= CoreDebug_DEMCR_TRCENA_Msk;
	if (DWT->CTRL & DWT_CTRL_NOCYCCNT_Msk) {
		return false;                               /* this core has no cycle counter */
	}
	DWT->CYCCNT = 0;
	DWT->CTRL |= DWT_CTRL_CYCCNTENA_Msk;
	uint32_t a = DWT->CYCCNT;
	for (volatile int i = 0; i < 16; i++) {
	}
	return DWT->CYCCNT != a;
}

/* CPU clock measured against the RTC over about 100 ms, so the cycles-per-second figure in the log is a measurement, not an assumption. */
static uint32_t measure_cpu_hz(void)
{
	uint32_t rtc_hz = sys_clock_hw_cycles_per_sec();
	uint32_t span = rtc_hz / 10u;
	uint32_t t0 = k_cycle_get_32();
	uint32_t c0 = DWT->CYCCNT;
	uint32_t dt;

	do {
		dt = k_cycle_get_32() - t0;
	} while (dt < span);
	uint32_t dc = DWT->CYCCNT - c0;

	return (uint32_t)(((uint64_t)dc * rtc_hz) / dt);
}

/* The cheapest possible measurement: two counter reads back to back, so the log shows what reading the counter itself costs. */
static uint32_t timer_overhead_min(void)
{
	uint32_t best = 0xFFFFFFFFu;
	for (int i = 0; i < 1000; i++) {
		unsigned key = irq_lock();
		uint32_t a = DWT->CYCCNT;
		uint32_t b = DWT->CYCCNT;
		irq_unlock(key);
		if (b - a < best) {
			best = b - a;
		}
	}
	return best;
}

int main(void)
{
	static const timing_platform_t plat = {
		.cycles = plat_cycles,
		.irq_lock = plat_irq_lock,
		.irq_unlock = plat_irq_unlock,
		.emit = plat_emit,
	};
	static const timing_fn_t fns[] = {
		{"cmp_naive", cmp_naive},
		{"cmp_ct", cmp_ct},
		{"cmp_memcmp", cmp_memcmp},
	};
	const struct device *con = DEVICE_DT_GET(DT_CHOSEN(zephyr_console));
	uint32_t dtr = 0;
	unsigned run = 0;

	if (!device_is_ready(con)) {
		return 0;
	}
	while (!dtr) {                                  /* wait until a terminal opens the port, so the first run is not lost */
		(void)uart_line_ctrl_get(con, UART_LINE_CTRL_DTR, &dtr);
		k_msleep(100);
	}
	k_msleep(1000);

	if (!dwt_start()) {
		for (;;) {
			printk("ERROR: the DWT cycle counter is not counting\n");
			k_sleep(K_SECONDS(2));
		}
	}

	for (;;) {
		printk("ENV zephyr %s\n", KERNEL_VERSION_STRING);
		printk("ENV board arduino_nano_33_ble (nRF52840, Cortex-M4F)\n");
		printk("ENV cpu_hz_measured %u\n", (unsigned)measure_cpu_hz());
		printk("ENV timer_overhead_min_cycles %u\n", (unsigned)timer_overhead_min());
		printk("ENV reps %u\n", REPEATS);
		run++;
		(void)timing_run(&plat, fns, 3, REPEATS, run);
		k_sleep(K_SECONDS(PAUSE_BETWEEN_RUNS_S));
	}
	return 0;
}
```
